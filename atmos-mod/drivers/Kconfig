## atmos-mod/drivers/Kconfig
```kconfig
menu "Device Drivers"
rsource "sensor/Kconfig"
endmenu

menu "DISPLAY"
rsource "display/Kconfig.sh1107"
endmenu
```

## atmos-mod/drivers/display/Kconfig.sh1107
```kconfig
menuconfig SH1107
  bool "SSH1107 display driver"
  default y
  select I2C
  select DISPLAY
  help
    SSH1107 I2C display driver
```

## atmos-mod/drivers/sensor/scd41/Kconfig
```kconfig
config SCD41
	bool "Sensirion SCD41 sensor"
	default y
	depends on DT_HAS_SENSIRION_SCD41_ENABLED
	select I2C
	select CRC
	help
	  Sensirion SCD41 CO2, Temperature, and Humidity sensor
```

## atmos-mod/drivers/sensor/sps30/Kconfig
```kconfig
config SPS30
	bool "Sensirion SPS30 sensor"
	default y
	depends on DT_HAS_SENSIRION_SPS30_ENABLED
	select I2C
	select CRC
	help
	  Sensirion SPS30 Particulate matter sensor
```

## atmos-mod/dts/bindings/display/sinowealth,sh1107.yaml
```yaml
# Copyright (c) 2023, TOKITA Hiroshi
# SPDX-License-Identifier: Apache-2.0

description: SH1107 128x64 dot-matrix display controller on I2C bus

compatible: "sinowealth,sh1107"

include: ["i2c-device.yaml"]

properties:
  width:
    type: int
    required: true
    description: The width of the display area
  height:
    type: int
    required: true
    description: The height of the display area

  page-offset:
    type: int
    default: 0
    description: Start address for Page Addressing Mode

  display-offset:
    type: int
    required: true
    description: mapping of the display start line to one of COM0 .. COM63

  multiplex-ratio:
    type: int
    required: true
    description: Multiplex Ratio

  segment-remap:
    type: boolean
    description: Last column address is mapped to first segment

  com-invdir:
    type: boolean
    description: Scan direction is from last COM output to first COM output

  com-sequential:
    type: boolean
    description: Sequential COM pin configuration

  prechargep:
    type: int
    required: true
    description: Duration of the pre-charge period

  reset-gpios:
    type: phandle-array
    description: RESET pin.

      The RESET pin of SSD1306 is active low.
      If connected directly the MCU pin should be configured
      as active low.

  inversion-on:
    type: boolean
    description: Turn on display color inverting

  ready-time-ms:
    type: int
    default: 10
    description: |
      Time it takes for the device from power up to become responsive and
      accepting commands. Defaults to 10ms (found by trial and error) if not
      provided.
```

## atmos-mod/dts/bindings/sensor/sensirion,scd41.yaml
```yaml
# Copyright (c) 2019, Linaro Limited
# SPDX-License-Identifier: Apache-2.0

description: Sensirion SCD41 integrated environmental sensor

compatible: "sensirion,scd41"

include: [sensor-device.yaml, i2c-device.yaml]
```

## atmos-mod/dts/bindings/sensor/sensirion,sps30.yaml
```yaml
# Copyright (c) 2019, Linaro Limited
# SPDX-License-Identifier: Apache-2.0

description: Sensirion SPS30 integrated environmental sensor

compatible: "sensirion,sps30"

include: [sensor-device.yaml, i2c-device.yaml]

properties:
  measurement-output-format:
    type: int
    required: true
    description: Measurement output Mode, <0x300> for float, <0x500> for Uint16.
```

## boards/arm/stm32f0_atmos/Kconfig.board
```kconfig
# STM32F0DISCOVERY development board with STM32F051R8 MCU configuration

# Copyright (c) 2018 Nathan Tsoi <nathan@vertile.com>
# SPDX-License-Identifier: Apache-2.0

config BOARD_STM32F0_ATMOS
	bool "STM32F0ATMOS Atmospherics Board"
	depends on SOC_STM32F030X8
```

## boards/arm/stm32f0_atmos/Kconfig.defconfig
```kconfig
# STM32F0 development board with STM32F051R8T6 MCU

# Copyright (c) 2018 Nathan Tsoi <nathan@vertile.com>
# SPDX-License-Identifier: Apache-2.0

if BOARD_STM32F0_ATMOS

config BOARD
	default "stm32f0_atmos"

endif # BOARD_STM32F0_DISCO
```

## module/drivers/sensor/scd41/Kconfig
```kconfig
menuconfig SCD41
	bool "Sensirion SCD41 sensor"
	default y
	depends on DT_HAS_SENSIRION_SCD41_ENABLED
	select I2C
	help
	  Sensirion SCD41 CO2, Temperature, and Humidity sensor
```

## stm32f0/west.yml
```yaml
# The west manifest file for upstream Zephyr.
#
# The per-installation west configuration file, .west/config, sets the
# path to the project containing this file in the [manifest] section's
# "path" variable.
#
# You are free to create your own manifest files and put them in any
# repository you want, to create your own custom Zephyr installations.
# For example, you could create a manifest file in your own out of
# tree application directory, which would pull this zephyr repository
# in as an ordinary project.
#
# You can pass your manifest repositories to west init when creating a
# new Zephyr installation. See the west documentation for more
# information.

manifest:
  defaults:
    remote: upstream

  remotes:
    - name: upstream
      url-base: https://github.com/zephyrproject-rtos
    - name: babblesim
      url-base: https://github.com/BabbleSim

  group-filter: [-babblesim, -optional]

  #
  # Please add items below based on alphabetical order
  projects:
    - name: acpica
      revision: 0333c2af13179f9b33d495cf7cb9a509f751cbb1
      path: modules/lib/acpica
    - name: canopennode
      revision: dec12fa3f0d790cafa8414a4c2930ea71ab72ffd
      path: modules/lib/canopennode
    - name: cmsis
      revision: 5a00331455dd74e31e80efa383a489faea0590e3
      path: modules/hal/cmsis
      groups:
        - hal
    - name: edtt
      revision: 64e5105ad82390164fb73fc654be3f73a608209a
      path: tools/edtt
      groups:
        - tools
    - name: fatfs
      revision: 427159bf95ea49b7680facffaa29ad506b42709b
      path: modules/fs/fatfs
      groups:
        - fs
    - name: hal_st
      revision: fb8e79d1a261fd02aadff7c142729f1954163cf3
      path: modules/hal/st
      groups:
        - hal
    - name: hal_stm32
      revision: 89ef0a3383edebf661073073bcdf6e2836fe90ee
      path: modules/hal/stm32
      groups:
        - hal
    - name: littlefs
      path: modules/fs/littlefs
      groups:
        - fs
      revision: ca583fd297ceb48bced3c2548600dc615d67af24
    - name: openthread
      revision: d62167ee34b091e7025c9ec2820aae71e17a3944
      path: modules/lib/openthread
    - name: percepio
      path: modules/debug/percepio
      revision: a3728efccc47dd372f40e6313589ca4c5cc7d5e9
      groups:
        - debug
    - name: picolibc
      path: modules/lib/picolibc
      revision: d07c38ff051386f8e09a143ea0a6c1d6d66dd1d8
    - name: segger
      revision: 9d0191285956cef43daf411edc2f1a7788346def
      path: modules/debug/segger
      groups:
        - debug
    - name: tinycrypt
      revision: 3e9a49d2672ec01435ffbf0d788db6d95ef28de0
      path: modules/crypto/tinycrypt
      groups:
        - crypto
    - name: zcbor
      revision: 67fd8bb88d3136738661fa8bb5f9989103f4599e
      path: modules/lib/zcbor
  self:
    path: zephyr
    west-commands: scripts/west-commands.yml
    import: submanifests
```
